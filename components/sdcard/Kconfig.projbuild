## components/sdcard/Kconfig.projbuild
```kconfig
menu "SD CARD SPI Configuration"

    config FORMAT_IF_MOUNT_FAILED
        bool "Format the card if mount failed"
        default n
        help
            If this config item is set, format_if_mount_failed will be set to true and the card will be formatted if
            the mount has failed.

    config PIN_MOSI
        int "MOSI GPIO number"
        default 32 if IDF_TARGET_ESP32
        default 35 if IDF_TARGET_ESP32S2
        default 35 if IDF_TARGET_ESP32S3
        default 4  # C3 and others

    config PIN_MISO
        int "MISO GPIO number"
        default 33 if IDF_TARGET_ESP32
        default 37 if IDF_TARGET_ESP32S2
        default 37 if IDF_TARGET_ESP32S3
        default 6  # C3 and others

    config PIN_CLK
        int "CLK GPIO number"
        default 23 if IDF_TARGET_ESP32
        default 36 if IDF_TARGET_ESP32S2
        default 36 if IDF_TARGET_ESP32S3
        default 5  # C3 and others

    config PIN_CS
        int "CS GPIO number"
        default 22 if IDF_TARGET_ESP32
        default 34 if IDF_TARGET_ESP32S2
        default 34 if IDF_TARGET_ESP32S3
        default 1  # C3 and others

endmenu
```

## components/wifi_station/Kconfig.projbuild
```kconfig
menu "WIFI Configuration"

    config LOAD_FROM_SD_CARD
        bool "Load WiFi SSID and Password from SD Card"
        default n
        help
            If this config item is set, WiFi SSID and Password will be loaded from SD Card.

    config ESP_WIFI_SSID
        depends on !LOAD_FROM_SD_CARD
        string "WiFi SSID"
        default "myssid"
        help
            SSID (network name) for the example to connect to.

    config ESP_WIFI_PASSWORD
        depends on !LOAD_FROM_SD_CARD
        string "WiFi Password"
        default "mypassword"
        help
            WiFi password (WPA or WPA2) for the example to use.

    config ESP_MAXIMUM_RETRY
        int "Maximum retry"
        default 5
        help
            Set the Maximum retry to avoid station reconnecting to the AP unlimited when the AP is really inexistent.
endmenu
```

## main/Kconfig.projbuild
```kconfig
menu "PIX Configuration"

    config PIX_GATEWAY_HOST
        string "Hostname do Gateway"
        default "pix.host.com"
        help
            Define o hostname do gateway

    config HOST_USE_HTTPS
        bool "Usar HTTPS"
        default y
        help
            Se este item estiver setado as chamadas ao Gateway serão feitas com HTTPS

endmenu
```

## sdkconfig.defaults
```kconfig
#
# Serial flasher config
#
#CONFIG_ESPTOOLPY_FLASHSIZE_4MB=y

#
# Partition Table
#
CONFIG_PARTITION_TABLE_CUSTOM=y
CONFIG_PARTITION_TABLE_CUSTOM_FILENAME="partitions.csv"
CONFIG_PARTITION_TABLE_FILENAME="partitions.csv"

#
# ESP32-specific
#
CONFIG_ESP32_DEFAULT_CPU_FREQ_240=y
CONFIG_ESP32_DEFAULT_CPU_FREQ_MHZ=240


CONFIG_ESP_MAIN_TASK_STACK_SIZE=18000

CONFIG_ESP_TASK_WDT=n

CONFIG_ESP_TLS_INSECURE=y
CONFIG_ESP_TLS_SKIP_SERVER_CERT_VERIFY=y
```
